/dts-v1/;
/plugin/;

/ {
    compatible = "brcm,bcm2835";

    fragment@0 {
        target = <&uart0>;  // 핵심 변경: uart1 → uart0
        __overlay__ {
            status = "okay";
            echodev {
                compatible = "brightlight,echodev";
                status = "okay";
            };
        };
    };
};
